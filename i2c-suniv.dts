i2c1: i2c@1c27400 {
	compatible = "allwinner,suniv-f1c100s-i2c";
	reg = <0x01C27400 0x100>;
	interrupts  = <8>;
	clocks = <&ccu CLK_BUS_I2C1>, <&ccu CLK_BUS_I2C1>;
	clock-names = "ahb", "mod";
	resets = <&ccu RST_BUS_I2C1>;
	status = "disabled";
	#address-cells = <1>;
	#size-cells = <0>;
};
